## drivers/input/misc/rbs_fod_mmi/Kconfig
```kconfig
config INPUT_EGIS_FOD_MMI
	tristate "EGIS fingerprint sensor MMI"
	default n
	help
	 Say Y here if you wish to include support for MMI EGIS finger print sensor.
	 If unsure, say N.

config EGIS_PANEL_NOTIFICATIONS
	bool "Panel Notification Support for egis"
	default n
	depends on INPUT_EGIS_FOD_MMI
	help
	 Say Y here if you wish to include support for MMI EGIS finger print sensor
         panel notification framework support.
	 If unsure, say N.
```

## drivers/input/touchscreen/goodix_berlin_mmi/Kconfig
```kconfig
#
# Goodix touchscreen driver configuration
#

menuconfig TOUCHSCREEN_GOODIX_BRL
	tristate "Goodix berlin touchscreen"
	help
	  Say Y here if you have a Goodix berlin series touch controller
	  to your system.

	  If build module, say M.
	  If unsure, say N.

if TOUCHSCREEN_GOODIX_BRL

config TOUCHSCREEN_GOODIX_BRL_SPI
	bool "support SPI bus connection"
	help
		Say Y here if the touchscreen is connected via SPI bus.

config GTP_FOD
	bool "supports FOD"
	help
		Say Y here to support FOD.

config GTP_LIMIT_USE_SUPPLIER
	bool "supports using supplier"
	help
		Say Y here to support using supplier.

config GTP_ENABLE_PM_QOS
	bool "GTP enable PM QOS"

config GOODIX_ESD_ENABLE
	bool "Goodix ESD enable"

config GTP_DDA_STYLUS
	bool "GTP DDA Stylus"

config BOARD_USES_DOUBLE_TAP_CTRL
	bool "Board uses Double Tap Control"

endif
```

## drivers/misc/awinic/Kconfig
```kconfig
# SPDX-License-Identifier: GPL-2.0-only
#
# Misc strange devices
#

menu "Awinic drivers"

source "drivers/misc/awinic/aw862x/Kconfig"
source "drivers/misc/awinic/aw862x_haptic_nv/Kconfig"
source "drivers/misc/awinic/aw869x/Kconfig"
source "drivers/misc/awinic/aw869xx/Kconfig"
source "drivers/misc/awinic/aw8624/Kconfig"
source "drivers/misc/awinic/aw8695/Kconfig"
source "drivers/misc/awinic/aw8697/Kconfig"
source "drivers/misc/awinic/haptic_hv/Kconfig"

endmenu
```

## drivers/power/qpnp_adaptive_charge/Kconfig
```kconfig
config QPNP_ADAPTIVE_CHARGE
        tristate "QPNP ADAPTIVE CHARGE"
        default n
        help
         Say Y here if you have a qpnp adaptive charge compatible
         device connected.

         This driver can also be built as a module.  If so, the module
         will be called qpnp_adaptive_charge. 

config ADAPTIVE_TOLERANCE_OPTIMIZATION
        tristate "QPNP ADAPTIVE TOLERACNE OPTIMIZATIONM"
        default n
        help
         Say Y here to enable a qpnp adaptive torelance optimization
         device connected.
```

## drivers/power/qpnp_smb_basic_charger/Kconfig
```kconfig
config QPNP_SMB_BASIC_CHARGER
        tristate "QPNP_SMB_BASIC_CHARGER"
        default n
        help
         Say Y here if you have a mmi charger compatible
         device connected.

         This driver can also be built as a module.  If so, the module
         will be called qpnp_smb_basic_charger.
```
